## conf/layer.conf
```bitbake
# We have a conf and classes directory, add to BBPATH
BBPATH .= ":${LAYERDIR}"

# We have recipes-* directories, add to BBFILES
BBFILES += "${LAYERDIR}/recipes-*/*/*.bb \
            ${LAYERDIR}/recipes-*/*/*.bbappend"

BBFILE_COLLECTIONS += "meta-awsapp"
BBFILE_PATTERN_meta-awsapp = "^${LAYERDIR}/"
BBFILE_PRIORITY_meta-awsapp = "6"

LAYERDEPENDS_meta-awsapp = "core"
LAYERDEPENDS_meta-awsapp += "meta-aws"

LAYERSERIES_COMPAT_meta-awsapp = "mickledore"
```
